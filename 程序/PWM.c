#include<reg52.h>    
#include<intrins.h>                        
#define uchar unsigned char	
#define uint unsigned int 
		
/**********************************************************************
							L298n接口定义
**********************************************************************/  
sbit MOTOR_A_1=P3^6;
sbit MOTOR_A_2=P3^7;																   
sbit k1=P1^0;		//定义k1为p1.0口
sbit k2=P1^1;   //定义k2为p1.1口
sbit k3=P1^2;   //定义k3为p1.2口
sbit k4=P1^3;   //定义k4为p1.3口
int T=0;	   //定时标记
int W=0;	   //脉宽值	 0~100
uchar A=0;	   //方向标记 0，1
uchar k=0;	   //按键标记
uchar i=0;    	 //计数变量

uchar code table1[]={
0x3f,0x06,0x5b,0x4f,
0x66,0x6d,0x7d,0x07,
0x7f,0x6f,0x77,0x7c,
0x39,0x5e,0x79,0x71};

uchar code table2[]={0xfe,0xfb,0xfd,0xf7};
		 
void delayms(uint t);					 			 
/**********************************************************************
						数码管显示
**********************************************************************/ 
void disp(void)
{
	P2=table2[3];					
	P0=table1[W%10];			//显示占空比个位
	delayms(3); 					//延时1ms
	P2=0xff;							//P0清1

	P2=table2[2];
	P0=table1[W/100]; 		//显示占空比百位
	delayms(3); 					//延时1ms
	P2=0xff;							//P0清1
  
	P2=table2[1];
	P0=table1[W/10%10];  //显示占空比十位
	delayms(3); 				 //延时1ms
	P2=0xff;   					 //P0清1

	P2=table2[0];
	P0=table1[A];  			//显示方向
	delayms(3); 				//延时1ms
	P2=0xff;						//P0清1
}

/**********************************************************************
							定时器变量定义
**********************************************************************/ 


void init(void)
{
	//启动中断
	TMOD=0x01;	
	EA=1;						
	ET0=1;
	TR0=1;
	//设置定时时间
	TH0=(65536-100)/256;
	TL0=(65536-100)%256;
}

void timer0() interrupt 1
{		  		   
	//重置定时器时间
	TH0=(65536-100)/256;
	TL0=(65536-100)%256;
	T++;	 		//定时标记加1 
	if(k==0)
	{
	if(T>W)
		MOTOR_A_1 =0;
	else
		MOTOR_A_1 =1;
	}
	else
	{
	if(T>W)
		MOTOR_A_2 =0;
	else
		MOTOR_A_2 =1;
	}
	  
	if(T==100)
		T=0; 
}			
/**********************************************************************
							延时1ms
**********************************************************************/ 
void delayms(uint t)
{
	uchar j;
	while(t--)
	{
		for(j=0;j<40;j++)			//循环250次
		{
		   _nop_();             //系统延时          
	       _nop_();							//系统延时
	       _nop_();							//系统延时
	       _nop_();							//系统延时
		}
	}
}
/**********************************************************************
							独立按键检测
**********************************************************************/ 
void key(void)           //按键判断程序
{
	if(k1==0)							//按键1按下
	{
		while(k1==0);				//按键1抬起
		if(W==100)					//如果脉宽为100
			W=0;							//脉宽置0
		else
			W+=1;							//否则加1
	}
	else if(k2==0)				//按键2按下
	{				 
		while(k2==0);				//按键2抬起
		if(W==0)						//如果脉宽为0
			W=100;						//脉宽设置成100
		else
			W-=1;							//否则减1
	}
	else if(k3==0)				//按键3按下
	{			   
		while(k3==0);				//按键3抬起
		A=!A;								//方向标记取反
		k=!k;								//按键标记取反
	} 
	else if(k4==0)				//按键4按下
	{			   
		while(k4==0);				//按键4抬起
		W=0;								//脉宽清0									
	}
}

void main(void)
{

	init();			/////////系统初始化 
	while(1)	 
	{
	disp();		//数码管显示
	if(k==0)
	    MOTOR_A_2=0;
	else
		MOTOR_A_1=0;	 		
		key();			////////查询按键
	}
}

/**********************************************************************
							  END
**********************************************************************/ 
